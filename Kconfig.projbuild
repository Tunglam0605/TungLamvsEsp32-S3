## Kconfig.projbuild
```kconfig
menu "Tung Lam ESP32-S3 platform"

config PLATFORM_BOARD_PROFILE_N16R8
    bool "Use Waveshare default N16R8 board profile"
    default y
    help
        The expected hardware is ESP32-S3-WROOM-1U-N16R8 (16 MB flash,
        8 MB PSRAM). Waveshare allows other module variants, so runtime
        checks remain authoritative for a connected board.

config PLATFORM_EXPECTED_FLASH_SIZE_MB
    int "Expected flash size in MiB"
    range 1 128
    default 16
    depends on PLATFORM_BOARD_PROFILE_N16R8

config PLATFORM_EXPECTED_PSRAM_SIZE_MB
    int "Expected PSRAM size in MiB"
    range 0 32
    default 8
    depends on PLATFORM_BOARD_PROFILE_N16R8

config PLATFORM_ENABLE_DI
    bool "Enable board digital-input BSP"
    default y

config PLATFORM_ENABLE_DO
    bool "Enable board digital-output BSP"
    default y

config PLATFORM_DI_ACTIVE_LOW_PROVISIONAL
    bool "Provisional DI logical-active mapping: raw LOW is active"
    default y
    depends on PLATFORM_ENABLE_DI
    help
        This is a provisional mapping, not an HIL-verified electrical fact.
        The hardware-test firmware logs raw and logical masks so it can be
        confirmed or changed without concealing the assumption.

config PLATFORM_DO_ACTIVE_HIGH_PROVISIONAL
    bool "Provisional DO logical-ON mapping: TCA9554 register HIGH is ON"
    default y
    depends on PLATFORM_ENABLE_DO
    help
        This is based on the vendor demo's logical convention and is not yet
        HIL-verified. BSP safe, desired, and applied masks remain logical;
        only the BSP converts them to the physical TCA9554 register value.

config PLATFORM_HARDWARE_TEST_RUN_OUTPUT_SEQUENCE
    bool "Run DO1-DO8 sequence at hardware-test boot"
    default n
    depends on PLATFORM_ENABLE_DO
    help
        Disabled by default to avoid actuating attached industrial loads.
        When enabled, the hardware-test application toggles one output at a
        time and always returns to the configured logical safe state.

endmenu
```

## components/callbox/Kconfig.projbuild
```kconfig
menu "CallBox HTTPS OTA"

config CALLBOX_OTA_HTTPS_ENABLE
    bool "Enable HTTPS manifest OTA source"
    default n
    help
        Enable the asynchronous CallBox HTTPS OTA source. The source never
        installs or reboots automatically; a staged image still needs the
        existing explicit install path.

config CALLBOX_OTA_HTTPS_MANIFEST_URL
    string "HTTPS OTA manifest URL"
    depends on CALLBOX_OTA_HTTPS_ENABLE
    default ""
    help
        Compile-time HTTPS URL for the small OTA manifest used by a future
        internal/server trigger. This is intentionally not stored in Config_t
        or NVS.

endmenu
```

## main/Kconfig.projbuild
```kconfig
menu "Callbox Security"

    config CALLBOX_PRODUCTION_BUILD
        bool "Require the production hardware-security profile"
        default n
        help
            Marks this firmware as a production image. CMake rejects the build
            unless Secure Boot V2, flash encryption in release mode, and NVS
            encryption are enabled. Enabling those ESP-IDF features can burn
            eFuses on first boot; follow docs/SECURITY.md before flashing.

    config CALLBOX_ALLOW_ANONYMOUS_MQTT
        bool "Allow MQTT without username/password (development only)"
        depends on !CALLBOX_PRODUCTION_BUILD
        default n
        help
            Allows connection to a broker without both a username and password.
            Keep this disabled except for an isolated development broker.

endmenu
```
